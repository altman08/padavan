## trunk/linux-4.4.x/drivers/crypto/mtk-eip93/Kconfig
```kconfig
# SPDX-License-Identifier: GPL-2.0
config CRYPTO_DEV_EIP93
	tristate "Support for EIP93 crypto HW accelerators"
	depends on SOC_MT7621 && CPU_LITTLE_ENDIAN && OF
	depends on HAS_DMA
	select CRYPTO_AES
	select CRYPTO_DES
	select CRYPTO_BLKCIPHER
	select CRYPTO_HASH
	select CRYPTO_AEAD
	select CRYPTO_AUTHENC
	select CRYPTO_CBC
	select CRYPTO_CTR
	select CRYPTO_MD5
	select CRYPTO_SHA1
	select CRYPTO_SHA256
	select CRYPTO_HMAC
	help
	  EIP93 have various crypto HW accelerators. Select this if
	  you want to use the EIP93 modules for any of the crypto algorithms.

	  If the IP supports it, this provide offload for AES - ECB, CBC and
	  CTR crypto. Also provide DES and 3DES ECB and CBC.

	  Also provide AEAD authenc(hmac(x), cipher(y)) for supported algo.
```
